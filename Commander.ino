
#include <Adafruit_GFX.h>
#include <Adafruit_SSD1306.h>
#include <Adafruit_NeoPixel.h>
#ifdef __AVR__
 #include <avr/power.h> // Required for 16 MHz Adafruit Trinket
#endif

//Byte array for the splash screen animation
const unsigned char splash2 [] PROGMEM = {0x00, 0x00, 0x00, 0x00, 0x00, 0x00, 0x00, 0x00, 0x00, 0x00, 0x00, 0x00, 0x00,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 0x00, 0x00};
const unsigned char splash3 [] PROGMEM = {0x00, 0x00, 0x00, 0x00, 0x00, 0x00, 0x00, 0x00, 0x00, 0x00, 0x00, 0x00, 0x00,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 0x00, 0x00};
const unsigned char splash4 [] PROGMEM = {0x00, 0x00, 0x00, 0x00, 0x00, 0x00, 0x00, 0x00, 0x00, 0x00, 0x00, 0x00, 0x00,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 0x00, 0x00};
const unsigned char splash5 [] PROGMEM = {0x00, 0x00, 0x00, 0x00, 0x00, 0x00, 0x00, 0x00, 0x00, 0x00, 0x00, 0x00, 0x00,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 0x00, 0x00};
const unsigned char splash6 [] PROGMEM = {0xfe, 0x00, 0x00, 0x00, 0x00, 0x00, 0x00, 0x00, 0x00, 0x00, 0x00, 0x00, 0x00,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 0x00, 0x00};
const unsigned char splash7 [] PROGMEM = {0xff, 0xfc, 0x00, 0x00, 0x00, 0x00, 0x00, 0x00, 0x00, 0x00, 0x00, 0x00, 0x00,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 0x00, 0x00};
const unsigned char splash8 [] PROGMEM = {0xff, 0xf1, 0xfc, 0x00, 0x00, 0x00, 0x00, 0x00, 0x00, 0x00, 0x00, 0x00, 0x00,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 0x00, 0x00};
const unsigned char splash9 [] PROGMEM = {0xff, 0xf0, 0x3f, 0xe7, 0xf0, 0x00, 0x00, 0x00, 0x00, 0x00, 0x00, 0x00, 0x00,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 0x00, 0x00};
const unsigned char splash10 [] PROGMEM = {0xff, 0xf0, 0x3f, 0xe3, 0xf3, 0xf1, 0xff, 0x3f, 0x80, 0x00, 0x00, 0x00, 0x00,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 0x00, 0x00};
const unsigned char splash11 [] PROGMEM = {0xff, 0xf0, 0x3f, 0xe3, 0xf3, 0xf1, 0xff, 0x03, 0xe3, 0xe3, 0xff, 0xfc, 0x00,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 0x00, 0x00};
const unsigned char splash12 [] PROGMEM = {0xff, 0xf0, 0x3f, 0xe3, 0xf3, 0xf1, 0xff, 0x03, 0xe3, 0xe3, 0xfe, 0x07, 0xff,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 0x00, 0x00};
const unsigned char splash13 [] PROGMEM = {0xff, 0xf0, 0x3f, 0xe3, 0xf3, 0xf1, 0xff, 0x03, 0xe3, 0xe3, 0xfe, 0x07, 0xff,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 0x00, 0x00};
const unsigned char splash14 [] PROGMEM = {0xff, 0xf0, 0x3f, 0xe3, 0xf3, 0xf1, 0xff, 0x03, 0xe3, 0xe3, 0xfe, 0x07, 0xff,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 0x00, 0x00};
const unsigned char splash15 [] PROGMEM = {0xff, 0xf0, 0x3f, 0xe3, 0xf3, 0xf1, 0xff, 0x03, 0xe3, 0xe3, 0xfe, 0x07, 0xff,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 0x00, 0x00};
const unsigned char splash16 [] PROGMEM = {0xff, 0xf0, 0x3f, 0xe3, 0xf3, 0xf1, 0xff, 0x03, 0xe3, 0xe3, 0xfe, 0x07, 0xff,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 0x00, 0x00};
const unsigned char splash17 [] PROGMEM = {0xff, 0xf0, 0x3f, 0xe3, 0xf3, 0xf1, 0xff, 0x03, 0xe3, 0xe3, 0xfe, 0x07, 0xff,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 0x00, 0x00};
const unsigned char splash21 [] PROGMEM = {0xff, 0xf0, 0x3f, 0xe3, 0xf3, 0xf1, 0xff, 0x03, 0xe3, 0xe3, 0xfe, 0x07, 0xff,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 0x00, 0x00};
const unsigned char splash22 [] PROGMEM = {0x00, 0x00, 0x3f, 0xe3, 0xf3, 0xf1, 0xff, 0x00, 0x00, 0x03, 0xfe, 0x07, 0xff,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 0x00, 0x00};
const unsigned char splash23 [] PROGMEM = {0xff, 0xf0, 0x3f, 0xe3, 0xf3, 0xf0, 0x00, 0x03, 0xe3, 0xe3, 0xfe, 0x00, 0x00,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 0x00, 0x00};
const unsigned char splash24 [] PROGMEM = {0x00, 0x00, 0x3f, 0xe0, 0x00, 0x01, 0xff, 0x00, 0x00, 0x00, 0x00, 0x07, 0xff,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 0x00, 0x00};
const unsigned char splash25 [] PROGMEM = {0x00, 0x00, 0x00, 0x03, 0xf3, 0xf0, 0x00, 0x00, 0x00, 0x03, 0xfe, 0x07, 0xff,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 0x00, 0x00};
const unsigned char splash26 [] PROGMEM = {0x00, 0x00, 0x3f, 0xe0, 0x00, 0x00, 0x00, 0x03, 0xe3, 0xe0, 0x00, 0x00, 0x00,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 0x00, 0x00};

const unsigned char* splashAnimation[22] = {splash2, splash3, splash4, splash5, splash6, splash7, splash8, splash9, splash10, splash11, splash12, splash13, splash14, splash15, splash16, splash17, splash21, splash22, splash23, splash24, splash25, splash26 };

//int topbar_line[][2] = {{2, 75}, {10, 80}, {17, 87}, {34, 100}, {52, 114}, {61, 119}, {70, 119}, {70, 119}, {70, 119}, {70, 119}, {70, 119}, {70, 119}, {70, 119}, {70, 119}, {70, 119}, {70, 119}, {70, 119}, {70, 119}, {70, 119}};
int topbarLine[7][2] = {{2, 75}, {10, 80}, {17, 87}, {34, 100}, {52, 114}, {61, 119}, {70, 119}};

//coordinates for the desbription box
int box_box[][4] = {{36, 100, 36, 100}, {36, 96, 36, 103}, {36, 94, 36, 106}, {36, 85, 36, 114}, {36, 78, 36, 122}, {36, 75, 36, 125}, {36, 71, 36, 128}, {36, 71, 36, 128}, {36, 71, 36, 128}, {32, 71, 39, 128}, {29, 71, 42, 128}, {22, 71, 49, 128}, {17, 71, 58, 128}, {14, 71, 60, 128}, {11, 71, 63, 128}, {11, 71, 63, 128}, {11, 71, 63, 128}, {11, 71, 63, 128}, {11, 71, 63, 128}, {11, 71, 63, 128}};
int box_box_line[7] = {1, 2, 4, 4, 4, 4, 4}; //helps the lines follow the box when it opens
int box_box_openerY[10] = {33, 30, 23, 18, 15, 12, 12, 12, 12, 12}; //this list is here cause arduino couldnt add one succsefuflly in the command itself :(

// Defining the pin the LEDs are connected to (D2)
#define LED_PIN    2

// Amount of LEDs
#define LED_COUNT  8

// Declare the LED strip object
Adafruit_NeoPixel strip(LED_COUNT, LED_PIN, NEO_GRB + NEO_KHZ800);
//define colors to use
uint32_t white = strip.Color(255, 255, 255);
uint32_t red = strip.Color(255, 0, 0);
uint32_t orange = strip.Color(255, 160, 0);
uint32_t yellow = strip.Color(255, 255, 0);
uint32_t green = strip.Color(0, 255, 0);
uint32_t cyan = strip.Color(0, 208, 255);
uint32_t blue = strip.Color(0, 70, 255);
uint32_t purple = strip.Color(170, 31, 255);
uint32_t pink = strip.Color(255, 0, 255);

//get these values from the EEPROM later but thet are setup with the proper checks so that this function is ready
bool MenuAnimation = true;
bool SplashAnimation = true;
uint32_t *TopColor = &cyan;
uint32_t *BottomColor = &pink;
int AutoScrollSpeed = 5; //lines per second

#define SCREEN_WIDTH 128 // OLED display width, in pixels
#define SCREEN_HEIGHT 64 // OLED display height, in pixels
#define OLED_RESET     -1 // Reset pin # (or -1 if sharing Arduino reset pin)
#define SCREEN_ADDRESS 0x3C ///< See datasheet for Address; 0x3D for 128x64, 0x3C for 128x32
Adafruit_SSD1306 display(SCREEN_WIDTH, SCREEN_HEIGHT, &Wire, OLED_RESET);

//char folders[6] = {"GENERAL","FINDER","TEXT","SYSTEM","POWER", "TIPS"};


void setup() {   

    //setup the pins for the Buttons
    pinMode(3, INPUT_PULLUP); //Up
    pinMode(4, INPUT_PULLUP); //Down
    pinMode(5, INPUT_PULLUP); //Left
    pinMode(6, INPUT_PULLUP); //Right

    Serial.begin(9600);

    //start the display object
    // SSD1306_SWITCHCAPVCC = generate display voltage from 3.3V internally
    display.begin(SSD1306_SWITCHCAPVCC, SCREEN_ADDRESS);

    //setup the LED strip
    strip.begin();
    strip.show();
    strip.setBrightness(255);

    //clear the display before we start so it doesnt show anything goofy like the arduino library splash screen (that i think i might be legally reqiured to do if i'm using the library and selling the code for profit)
    display.clearDisplay();
    display.display();
    delay(200);

    if (SplashAnimation == true) { //make sure the user wants the Splash animation or not
        for (int i = 0; i < 22; i++) { //start of Splash screen 
            if (i < 19) { //fades in the LEDs by mapping the frame count to the brightness
                strip.setBrightness(map(i, 0, 17, 0, 255));
                strip.fill(white, 0, 8);
                strip.show();
            } else { //when the logo is blinking out blink out the LEDs too randomly
                strip.setBrightness(255);
                strip.fill(white, 0, 8);
                strip.setPixelColor(random(0, 8), 0, 0, 0);
                strip.setPixelColor(random(0, 8), 0, 0, 0);
                strip.setPixelColor(random(0, 8), 0, 0, 0);
                strip.show();
            }

            display.clearDisplay();
            display.drawBitmap(4, 20, splashAnimation[i], 120, 23, WHITE); //goes through each frame of the splash screen animation
            if (i == 17) { //once its on the last frame hold it for a while so you can see the splash screen, then it continues to blink out
                delay(1200);
            }
            display.display();
        }
    } else {
        display.drawBitmap(4, 20, splashAnimation[22], 120, 23, WHITE);
        display.display();
        delay(120);
    }
    //once the splash screen is done turn off all the LEDs and clear the display. 
    strip.clear();
    strip.show();
    display.clearDisplay();
    display.display();
    if (MenuAnimation == true) {
        for (int i = 0; i < 19; i++) { //epic animation to slide in the menu
            display.clearDisplay(); //clears the display to get ready to draw the new one

            if (i < 13 & i > 7) { //blink in the colored LEDs with a little delay in accordance to the frame count
                strip.fill(*BottomColor, 0, 4);
                strip.fill(*TopColor, 4, 8);
                strip.setPixelColor(random(0, 8), 0, 0, 0);
                strip.setPixelColor(random(0, 8), 0, 0, 0);
                strip.setPixelColor(random(0, 8), 0, 0, 0);
            } else if (i < 7) { //keep the LEDs off before the delay
                strip.clear();
            } else { //keep them on after they blinked in
                strip.fill(*BottomColor, 0, 4);
                strip.fill(*TopColor, 4, 8);
            }
            strip.show(); //show the animations on the LEDs

            //draws the main description box with accordance to the coordinates in the box_box list
            display.fillRect(box_box[i][1], box_box[i][0], (box_box[i][3] - box_box[i][1]), (box_box[i][2] - box_box[i][0]) + 1, WHITE);
            if (i > 9) { //draws the inner box so there like a sweeping effect for when it opens
                display.fillRect(72, box_box_openerY[i-10], (box_box[i-1][3] - box_box[i-1][1]) - 2, (box_box[i-1][2] - box_box[i-1][0]) - 1, BLACK);
            }
            if (i > 12) {
                //draws the trinagles on the edges on the rectangle to chamfer the edges.
                display.fillTriangle(75, 11, 71, 15, 71, 11, BLACK);
                display.fillTriangle(124, 63, 128, 59, 128, 63, BLACK);
                //draws the lines and increases it's length based on the list and frame count
                display.drawLine(71 + box_box_line[i-12], 16 - box_box_line[i-12], 71, 16, WHITE);
                display.drawLine(128 - box_box_line[i-12], 58 + box_box_line[i-12], 128, 58, WHITE);
            }

            /*
            if (i > 7) {
                display.drawLine(0, 10, topbarLine[6][0], 10, WHITE);
                //display.drawLine(75, 5, topbar_line[7][1], 5, WHITE);
            } else {
                Serial.println("aaaa");
                //Serial.println("TopBar: "+ String(9)+ "|  Index: " + String(i));
                //display.drawLine(0, 10, topbarLine[i][0], 10, WHITE);
                //display.drawLine(75, 5, topbar_line[i][1], 5, WHITE);
            }
            */
            
            
            
            //This is to display the current frame or "i" so I can debug animations based on frame count.
            display.setCursor(0, 0);
            display.setTextColor(SSD1306_WHITE);
            display.println(i);
            //display.setCursor(0,0);
            //display.println("WELCOME");

            display.display(); //display the frame we just drew
            delay(100);
            
        }
    } else {
        //description box
        display.fillTriangle(75, 11, 71, 15, 71, 11, BLACK);
        display.fillTriangle(124, 63, 128, 59, 128, 63, BLACK);
        //draws the lines and increases it's length based on the list and frame count
        display.drawLine(71 + box_box_line[6], 16 - box_box_line[6], 71, 16, WHITE);
        display.drawLine(128 - box_box_line[6], 58 + box_box_line[6], 128, 58, WHITE);
    }
    //end of splashscreen
    delay(5000);

}

void loop() { //all of this isnt part of the actual code yet and will be changed
    int press_start;
    display.clearDisplay(); //clear the display to start with a blank slate
    display.setCursor(0,0);
    display.setTextColor(SSD1306_WHITE);
    if (digitalRead(3) == HIGH & digitalRead(4) == HIGH & digitalRead(5) == HIGH & digitalRead(6) == HIGH) {
        press_start = millis();
    } //once a button is pressed start timing it to later detect long presses (will be used to scroll faster through the menus)

    if (int(millis() - press_start) > 500) {
        display.setCursor(10, 0);
    } //if its been pressed for over 500 miliseconds indent the text to show that its been detected

    if (digitalRead(3) == LOW) { //display the corresponding direction with the button that has been pressed.
        display.println("UP");
    } else if (digitalRead(4) == LOW) {
        display.println("DOWN");
    } else if (digitalRead(5) == LOW) {
        display.println("LEFT");
    } else if (digitalRead(6) == LOW) {
        display.println("RIGHT");
    }
    display.display(); //display changes
}

/* STUFF TO STILL CODE IN

A working menu
    - Complete the UI with the animation
        • Finished description box
        • Top Bar
        • Text Handles
        • Text
        • Selection pointer
        • Top Welcome Text
    - Create lists of folders and commands
        • list of different levels. For example when entering the General category it would then begin to reference the General list instal of another inbedded list.
    - create a way to show the currently selected item
    - navigation with the four buttons (up and down do exactly what they say. right and left go in and out folders respectively)
    - Animation for entering a folder?

Settings menu
    - Save customization options to EEPROM
        • Top and Bottom LED colors. Maybe some more special options like gradients?
        • Automatic scroll speed
        • Enable or Disable the spash screen animation (disabled would show just the splash screen image so it goes faster)
        • Enable or Disable menu animations (disabled just goes faster but doesnt look as cool...)
    - temporary dev mode to show frame counts etc.

*/
